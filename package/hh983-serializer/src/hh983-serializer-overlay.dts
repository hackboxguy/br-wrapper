// SPDX-License-Identifier: GPL-2.0
/*
 * Device Tree Overlay for HH983 FPDLink Serializer
 *
 * Usage: Add to /boot/config.txt:
 *   dtoverlay=hh983-serializer
 *
 * Optional parameters:
 *   dtoverlay=hh983-serializer,addr=0x18
 *
 * The driver mode is controlled via module parameter, not from the overlay:
 *   /etc/modprobe.d/hh983.conf: options hh983-serializer config_mode=<0|1|2>
 *     0 = 983 + 984  (REM_INTB forwarding)
 *     1 = 983 + 988  (TDDI touch via I2C pass-through + REM_INTB).  The
 *         deserializer I2C port carrying the TDDI is probed at init (Port 1
 *         then Port 0), because the 12.3" boards differ: NQ5 has it on Port 1,
 *         NQ1.1 on Port 0.  Override with the tddi_port parameter if ever
 *         needed; the default suits both.
 *     2 = 983 + 988  video only, no touch (3x QVue); pass-through only, so the
 *         983 target slots the RH850 used to alias the 988 are left alone
 *
 * All three modes also take dtg_check (default 1), which detects a wedged
 * deserializer DTG - measured input line length away from the line length the
 * 983 is sending, which blanks the panel - and pulses the DTG to recover it.
 * See MODULE_PARM_DESC in hh983-serializer.c for the full parameter list.
 */

/dts-v1/;
/plugin/;

/ {
	compatible = "brcm,bcm2711";

	/* Define configurable parameters */
	fragment@0 {
		target = <&i2c1>;
		__overlay__ {
			#address-cells = <1>;
			#size-cells = <0>;
			status = "okay";

			hh983: serializer@18 {
				compatible = "ti,hh983-serializer";
				reg = <0x18>;
				status = "okay";
			};
		};
	};

	/* Allow address override via dtoverlay parameter */
	__overrides__ {
		addr = <&hh983>,"reg:0";
	};
};
