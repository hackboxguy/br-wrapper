## package/himax-touch-oled/Config.in
```kconfig
config BR2_PACKAGE_HIMAX_TOUCH_OLED
	bool "himax-touch-oled"
	depends on BR2_LINUX_KERNEL
	select BR2_PACKAGE_HH983_SERIALIZER
	help
	  Himax HX8530(C) TDDI touchscreen driver for the OLED-OTS 17.3"
	  panel, behind a DS90UB983/984 FPD-Link IV pair. Single-IC build
	  (module himax_oled, DT compatible "himax,hxoled"), kept separate
	  from the multi-chip himax-touch package because HX8530 is
	  incompatible with that build. Installs a DT overlay for RPi4.

	  Enable on the OTS-OLED board only; do not also enable himax-touch.
```

## package/himax-touch-oledib/Config.in
```kconfig
config BR2_PACKAGE_HIMAX_TOUCH_OLEDIB
	bool "himax-touch-oledib"
	depends on BR2_LINUX_KERNEL
	select BR2_PACKAGE_HH983_SERIALIZER
	help
	  Himax HX8530 touchscreen driver for the 17" OLED-IB panel
	  (2560x1440), behind a DS90UH983/988 FPD-Link IV pair. Himax's
	  sample code A09.23, which matches the panel's touch firmware;
	  module himax_oledib, DT compatible "himax,hxoledib". Installs a
	  DT overlay for RPi4.

	  Enable on the OLED-IB only; it excludes himax-touch and
	  himax-touch-oled on the same board.
```

## package/network-manager-app/Config.in
```kconfig
config BR2_PACKAGE_NETWORK_MANAGER_APP
	bool "network-manager-app"
	depends on BR2_PACKAGE_QT5
	select BR2_PACKAGE_QT5BASE_GUI
	select BR2_PACKAGE_QT5DECLARATIVE
	select BR2_PACKAGE_QT5DECLARATIVE_QUICK
	help
	  Network for the display rig: what every network interface is
	  doing, WiFi (scan, join, saved networks), and later the wired
	  ports' modes and bench diagnostics. Everything goes through
	  net-ctl.sh, which drives NetworkManager (nmcli); without
	  NetworkManager the app says so. Started from qt-demo-launcher's
	  "Network" button.
```

## package/system-manager-app/Config.in
```kconfig
config BR2_PACKAGE_SYSTEM_MANAGER_APP
	bool "system-manager-app"
	depends on BR2_PACKAGE_QT5
	select BR2_PACKAGE_QT5BASE_GUI
	select BR2_PACKAGE_QT5DECLARATIVE
	select BR2_PACKAGE_QT5DECLARATIVE_QUICK
	help
	  System Manager for the display rig. Its firmware section shows the firmware each
	  board runs (983HH serializer board, display controller) against
	  the images this system ships, and installs them over I2C through
	  update-iocs.sh (space6-architecture disptool). Started from
	  qt-demo-launcher's "System Manager" button.
```
