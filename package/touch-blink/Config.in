## package/touch-blink/Config.in
```kconfig
config BR2_PACKAGE_TOUCH_BLINK
        bool "touch-blink"
        select BR2_PACKAGE_LIBEVDEV
	default n
        help
          A demo utility to test the touchscreen by blinking an led upon touch action
```

## package/touch-gallery/Config.in
```kconfig
config BR2_PACKAGE_TOUCH_GALLERY
    bool "touch-gallery"
    depends on BR2_PACKAGE_QT5
    select BR2_PACKAGE_QT5DECLARATIVE
    select BR2_PACKAGE_QT5QUICKCONTROLS2
    help
      Simple touch-friendly image gallery using Qt5 QML
      Designed for framebuffer displays with touch input.
```

## package/touch-tester/Config.in
```kconfig
config BR2_PACKAGE_TOUCH_TESTER
	bool "touch-tester"
	select BR2_PACKAGE_LIBGPIOD
	help
	  Touch latency measurement and testing utility for embedded systems.

	  This package provides tools for measuring touch input latency,
	  counting touch events, and generating test touch pulses using
	  GPIO-controlled capacitive auto-clickers.

	  Components:
	  - libtouch-test: Core library for GPIO control, touch event
	    reading, and latency measurement
	  - touch-tester: Command-line tool for automated testing
	  - qt-touch-tester: Qt5 GUI application with network daemon mode
	    (requires Qt5 to be enabled)

	  Typical use cases:
	  - Automotive head-unit touch display testing
	  - Touch controller latency characterization
	  - Touch event reliability testing

	  https://github.com/your-org/br-wrapper
```

## package/xc3sprog/Config.in
```kconfig
config BR2_PACKAGE_XC3SPROG
	bool "xc3sprog"
	depends on BR2_USE_MMU # cmake
	depends on BR2_INSTALL_LIBSTDCPP
	depends on BR2_TOOLCHAIN_HAS_THREADS
	select BR2_PACKAGE_LIBFTDI if !BR2_PACKAGE_XC3SPROG_LIBFTDI1
	select BR2_PACKAGE_LIBUSB if !BR2_PACKAGE_XC3SPROG_LIBFTDI1
	select BR2_PACKAGE_LIBUSB_COMPAT if !BR2_PACKAGE_XC3SPROG_LIBFTDI1
	select BR2_PACKAGE_LIBFTDI1 if BR2_PACKAGE_XC3SPROG_LIBFTDI1
	select BR2_PACKAGE_LIBGPIOD if BR2_PACKAGE_XC3SPROG_GPIOD_SUPPORT
	help
	  xc3sprog is a suite of utilities for programming Xilinx FPGAs, 
	  CPLDs, and configuration PROMs via JTAG interface. It supports 
	  various JTAG adapters including FTDI-based cables and GPIO-based 
	  interfaces.

	  This version includes enhanced features:
	  - FPGA JTAG flasher wrapper script with auto-detection
	  - SPI flash programming support
	  - GPIO-based JTAG interface support
	  - Comprehensive device database

	  https://github.com/hackboxguy/xc3sprog

if BR2_PACKAGE_XC3SPROG

config BR2_PACKAGE_XC3SPROG_LIBFTDI1
	bool "use libftdi1 (1.x) instead of legacy libftdi"
	help
	  Use newer libftdi1 instead of legacy libftdi 0.x. 
	  Note: May have CMake compatibility issues with some Buildroot versions.
	  If build fails, disable this option to use legacy libftdi.

config BR2_PACKAGE_XC3SPROG_GPIOD_SUPPORT
	bool "GPIO support via libgpiod"
	help
	  Enable GPIO-based JTAG interface support using libgpiod.
	  This allows using GPIO pins (e.g., on Raspberry Pi) as JTAG
	  interface without additional hardware.

config BR2_PACKAGE_XC3SPROG_FTD2XX_SUPPORT
	bool "FTDI FTD2XX proprietary driver support"
	help
	  Enable support for FTDI's proprietary FTD2XX driver instead
	  of the open-source libftdi. This may provide better performance
	  with some FTDI-based JTAG adapters.

endif

comment "xc3sprog needs a toolchain w/ C++, threads, MMU"
	depends on !BR2_USE_MMU || !BR2_INSTALL_LIBSTDCPP || \
		!BR2_TOOLCHAIN_HAS_THREADS
```

## package/xilinx-test-tools/Config.in
```kconfig
config BR2_PACKAGE_XILINX_TEST_TOOLS
        bool "xilinx-test-tools"
        default n
        help
          set of utils used in testing or demo purpose on xilinx fpga+soc platforms(e.g zynq)
```
