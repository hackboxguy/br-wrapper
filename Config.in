## package/photoqt/Config.in
```kconfig
config BR2_PACKAGE_PHOTOQT
    bool "photoqt"
    depends on BR2_PACKAGE_QT5
    select BR2_PACKAGE_QT5DECLARATIVE
    select BR2_PACKAGE_QT5MULTIMEDIA
    select BR2_PACKAGE_QT5IMAGEFORMATS
    select BR2_PACKAGE_QT5QUICKCONTROLS
    select BR2_PACKAGE_QT5QUICKCONTROLS2
    select BR2_PACKAGE_QT5SVG
    select BR2_PACKAGE_QT5BASE_DBUS
    select BR2_PACKAGE_QT5BASE_SQL
    select BR2_PACKAGE_QT5BASE_SQLITE_QT
    select BR2_PACKAGE_QT5BASE_CONCURRENT
    select BR2_PACKAGE_QT5BASE_PRINTSUPPORT
    select BR2_PACKAGE_QT5BASE_XML
    select BR2_PACKAGE_QT5GRAPHICALEFFECTS
    help
      PhotoQt is a fast and highly configurable image viewer with a simple
      and nice interface. It supports touch gestures including pinch-to-zoom
      and swipe navigation.
      
      https://photoqt.org
```

## package/preemptrt-gpiotest/Config.in
```kconfig
config BR2_PACKAGE_PREEMPTRT_GPIOTEST
        bool "preemptrt-gpiotest"
        select BR2_PACKAGE_LIBGPIOD
	default n
        help
          A utility used for testing the preempt-rt latency on gpio pin using an oscilloscope
```

## package/qt-cluster-demo/Config.in
```kconfig
config BR2_PACKAGE_QT_CLUSTER_DEMO
	bool "qt-cluster-demo"
	depends on BR2_PACKAGE_QT5BASE
	select BR2_PACKAGE_QT5BASE_OPENGL
	select BR2_PACKAGE_QT5DECLARATIVE
	help
	  Qt/QML automotive instrument cluster demo.
	  Reads OBD2 data from CAN bus and renders
	  speedometer, tachometer, and gauges.
```

## package/qt-demo-launcher/Config.in
```kconfig
config BR2_PACKAGE_QT_DEMO_LAUNCHER
	bool "qt-demo-launcher"
	depends on BR2_PACKAGE_QT5BASE
	depends on BR2_PACKAGE_QT5BASE_WIDGETS
	help
	  Qt Demo Launcher for embedded devices.
	  
	  Simple launcher application that provides a menu to
	  launch different Qt demo programs on embedded devices.
```

## package/qt-mpv-wrapper/Config.in
```kconfig
config BR2_PACKAGE_QT_MPV_WRAPPER
	bool "qt-mpv-wrapper"
	depends on BR2_PACKAGE_QT5
	select BR2_PACKAGE_QT5BASE
	select BR2_PACKAGE_QT5DECLARATIVE
	select BR2_PACKAGE_QT5QUICKCONTROLS2
	help
	  Qt-based video player wrapper for mpv.
	  Provides file browser with touch-optimized playback controls.
```

## package/spotread/Config.in
```kconfig
config BR2_PACKAGE_SPOTREAD
	bool "spotread"
	depends on BR2_USE_MMU # fork()
	depends on BR2_TOOLCHAIN_HAS_THREADS
	select BR2_PACKAGE_LIBUSB
	select BR2_PACKAGE_XORG7
	select BR2_PACKAGE_XLIB_LIBX11
	help
	  Real ArgyllCMS spotread extracted from Debian package.
	  Includes full color measurement functionality for i1Display Pro
	  and other colorimeters. Console-only, minimal X11 dependency.

comment "spotread needs a toolchain w/ threads"
	depends on BR2_USE_MMU
	depends on !BR2_TOOLCHAIN_HAS_THREADS
```
