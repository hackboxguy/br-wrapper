## configs/beaglebone_preemptrt_defconfig
```kconfig
BR2_arm=y
BR2_cortex_a8=y
BR2_ARM_FPU_VFPV3=y
BR2_TOOLCHAIN_BUILDROOT_GLIBC=y
BR2_PACKAGE_HOST_LINUX_HEADERS_CUSTOM_5_15=y
BR2_TOOLCHAIN_BUILDROOT_CXX=y
BR2_ROOTFS_DEVICE_CREATION_DYNAMIC_MDEV=y
BR2_TARGET_GENERIC_ROOT_PASSWD="brb0x"
BR2_ROOTFS_OVERLAY="$(BR2_EXTERNAL_BRWRAPPER_PATH)/board/beaglebone-preemptrt-demo/fs-overlay/"
BR2_ROOTFS_POST_BUILD_SCRIPT="board/beaglebone/post-build.sh"
BR2_ROOTFS_POST_IMAGE_SCRIPT="support/scripts/genimage.sh"
BR2_ROOTFS_POST_SCRIPT_ARGS="-c board/beaglebone/genimage.cfg"
BR2_LINUX_KERNEL=y
BR2_LINUX_KERNEL_CUSTOM_GIT=y
BR2_LINUX_KERNEL_CUSTOM_REPO_URL="git://git.kernel.org/pub/scm/linux/kernel/git/rt/linux-stable-rt.git"
BR2_LINUX_KERNEL_CUSTOM_REPO_VERSION="v5.15.70-rt50"
BR2_LINUX_KERNEL_USE_CUSTOM_CONFIG=y
BR2_LINUX_KERNEL_CUSTOM_CONFIG_FILE="$(BR2_EXTERNAL_BRWRAPPER_PATH)/board/beaglebone-preemptrt-demo/linux.config"
BR2_LINUX_KERNEL_DTS_SUPPORT=y
BR2_LINUX_KERNEL_INTREE_DTS_NAME="am335x-evm am335x-bone am335x-boneblack am335x-bonegreen am335x-evmsk am335x-boneblue am335x-boneblack-wireless"
BR2_LINUX_KERNEL_NEEDS_HOST_OPENSSL=y
BR2_PACKAGE_LINUX_TOOLS_PERF=y
BR2_PACKAGE_RT_TESTS=y
BR2_PACKAGE_STRESS_NG=y
BR2_PACKAGE_POWERTOP=y
BR2_PACKAGE_PYTHON3=y
BR2_PACKAGE_LIBGPIOD_TOOLS=y
BR2_PACKAGE_DROPBEAR=y
BR2_PACKAGE_FPING=y
BR2_PACKAGE_IPERF3=y
BR2_PACKAGE_SCREEN=y
BR2_PACKAGE_HTOP=y
BR2_PACKAGE_UTIL_LINUX=y
BR2_TARGET_ROOTFS_EXT2=y
BR2_TARGET_ROOTFS_EXT2_4=y
BR2_TARGET_UBOOT=y
BR2_TARGET_UBOOT_BUILD_SYSTEM_KCONFIG=y
BR2_TARGET_UBOOT_CUSTOM_VERSION=y
BR2_TARGET_UBOOT_CUSTOM_VERSION_VALUE="2021.04"
BR2_TARGET_UBOOT_BOARD_DEFCONFIG="am335x_evm"
BR2_TARGET_UBOOT_NEEDS_DTC=y
# BR2_TARGET_UBOOT_FORMAT_BIN is not set
BR2_TARGET_UBOOT_FORMAT_IMG=y
BR2_TARGET_UBOOT_SPL=y
BR2_TARGET_UBOOT_SPL_NAME="MLO"
BR2_PACKAGE_HOST_DOSFSTOOLS=y
BR2_PACKAGE_HOST_GENIMAGE=y
BR2_PACKAGE_HOST_MTOOLS=y
BR2_PACKAGE_HOST_UBOOT_TOOLS=y
BR2_PACKAGE_HOST_UBOOT_TOOLS_FIT_SUPPORT=y
BR2_PACKAGE_PREEMPTRT_GPIOTEST=y
```

## configs/olimex_a20_olinuxino_som204_defconfig
```kconfig
BR2_arm=y
BR2_cortex_a7=y
BR2_ARM_FPU_NEON_VFPV4=y
BR2_TOOLCHAIN_BUILDROOT_GLIBC=y
BR2_PACKAGE_HOST_LINUX_HEADERS_CUSTOM_5_14=y
BR2_TARGET_GENERIC_HOSTNAME="a20-olinuxino"
BR2_TARGET_GENERIC_ISSUE="Welcome to OLinuXino!"
BR2_TARGET_GENERIC_GETTY_PORT="ttyS0"
BR2_ROOTFS_OVERLAY="$(BR2_EXTERNAL_BRWRAPPER_PATH)/board/a20_olinuxino/fs-overlay"
BR2_ROOTFS_POST_IMAGE_SCRIPT="support/scripts/genimage.sh"
BR2_ROOTFS_POST_SCRIPT_ARGS="-c board/olimex/a20_olinuxino/genimage.cfg"
BR2_LINUX_KERNEL=y
BR2_LINUX_KERNEL_CUSTOM_VERSION=y
BR2_LINUX_KERNEL_CUSTOM_VERSION_VALUE="5.14.13"
BR2_LINUX_KERNEL_DEFCONFIG="sunxi"
BR2_LINUX_KERNEL_CONFIG_FRAGMENT_FILES="board/olimex/a20_olinuxino/linux-disable-lima.fragment"
BR2_LINUX_KERNEL_DTS_SUPPORT=y
BR2_LINUX_KERNEL_INTREE_DTS_NAME="sun7i-a20-olimex-som204-evb"
BR2_LINUX_KERNEL_INSTALL_TARGET=y
BR2_PACKAGE_SUNXI_TOOLS=y
BR2_PACKAGE_SUNXI_MALI_UTGARD=y
BR2_PACKAGE_CHRONY=y
BR2_PACKAGE_DROPBEAR=y
BR2_TARGET_ROOTFS_EXT2=y
BR2_TARGET_ROOTFS_EXT2_4=y
# BR2_TARGET_ROOTFS_TAR is not set
BR2_TARGET_UBOOT=y
BR2_TARGET_UBOOT_BUILD_SYSTEM_KCONFIG=y
BR2_TARGET_UBOOT_CUSTOM_VERSION=y
BR2_TARGET_UBOOT_CUSTOM_VERSION_VALUE="2021.10"
BR2_TARGET_UBOOT_BOARD_DEFCONFIG="A20-Olimex-SOM204-EVB"
BR2_TARGET_UBOOT_NEEDS_DTC=y
BR2_TARGET_UBOOT_NEEDS_PYLIBFDT=y
BR2_TARGET_UBOOT_NEEDS_OPENSSL=y
BR2_TARGET_UBOOT_SPL=y
BR2_TARGET_UBOOT_SPL_NAME="u-boot-sunxi-with-spl.bin"
BR2_PACKAGE_HOST_GENIMAGE=y
BR2_PACKAGE_HOST_UBOOT_TOOLS=y
```

## configs/raspberrypi4_aws_iot_defconfig
```kconfig
BR2_arm=y
BR2_cortex_a72=y
BR2_ARM_FPU_NEON_VFPV4=y
BR2_PACKAGE_HOST_LINUX_HEADERS_CUSTOM_5_10=y
BR2_TOOLCHAIN_BUILDROOT_CXX=y
BR2_TARGET_GENERIC_ROOT_PASSWD="brb0x"
BR2_SYSTEM_DHCP="eth0"
BR2_ROOTFS_OVERLAY="$(BR2_EXTERNAL_BRWRAPPER_PATH)/board/aws-iot-demo/fs-overlay"
BR2_ROOTFS_POST_BUILD_SCRIPT="$(BR2_EXTERNAL_BRWRAPPER_PATH)/board/aws-iot-demo/raspberrypi4/post-build.sh"
BR2_ROOTFS_POST_IMAGE_SCRIPT="$(BR2_EXTERNAL_BRWRAPPER_PATH)/board/aws-iot-demo/raspberrypi4/post-image.sh"
BR2_LINUX_KERNEL=y
BR2_LINUX_KERNEL_CUSTOM_TARBALL=y
BR2_LINUX_KERNEL_CUSTOM_TARBALL_LOCATION="$(call github,raspberrypi,linux,0b54dbda3cca2beb51e236a25738784e90853b64)/linux-0b54dbda3cca2beb51e236a25738784e90853b64.tar.gz"
BR2_LINUX_KERNEL_DEFCONFIG="bcm2711"
BR2_LINUX_KERNEL_DTS_SUPPORT=y
BR2_LINUX_KERNEL_INTREE_DTS_NAME="bcm2711-rpi-4-b"
BR2_LINUX_KERNEL_NEEDS_HOST_OPENSSL=y
BR2_PACKAGE_RPI_FIRMWARE=y
BR2_PACKAGE_RPI_FIRMWARE_VARIANT_PI4=y
BR2_PACKAGE_RPI_FIRMWARE_CONFIG_FILE="board/raspberrypi4/config_4.txt"
BR2_PACKAGE_NETTLE=y
BR2_PACKAGE_LIBCURL=y
BR2_PACKAGE_LIBTASN1=y
BR2_PACKAGE_CHRONY=y
BR2_PACKAGE_DROPBEAR=y
BR2_PACKAGE_UTIL_LINUX=y
BR2_TARGET_ROOTFS_EXT2=y
BR2_TARGET_ROOTFS_EXT2_4=y
BR2_TARGET_ROOTFS_EXT2_SIZE="120M"
# BR2_TARGET_ROOTFS_TAR is not set
BR2_PACKAGE_HOST_CMAKE=y
BR2_PACKAGE_HOST_DOSFSTOOLS=y
BR2_PACKAGE_HOST_GENIMAGE=y
BR2_PACKAGE_HOST_MTOOLS=y
BR2_PACKAGE_AWS_IOT_PUBSUB_AGENT=y
```

## configs/raspberrypi4_touch_demo_defconfig
```kconfig
BR2_aarch64=y
BR2_cortex_a72=y
BR2_ARM_FPU_VFPV4=y
BR2_PACKAGE_HOST_LINUX_HEADERS_CUSTOM_6_1=y
BR2_TOOLCHAIN_BUILDROOT_CXX=y
BR2_GLOBAL_PATCH_DIR="$(BR2_EXTERNAL_BRWRAPPER_PATH)/board/pi4-touch-demo/br-patches"
BR2_TARGET_GENERIC_ISSUE="Welcome to Brbox"
BR2_INIT_SYSTEMD=y
BR2_TARGET_GENERIC_ROOT_PASSWD="brb0x"
BR2_SYSTEM_DHCP="eth0"
BR2_SYSTEM_DEFAULT_PATH="/bin:/sbin:/usr/bin:/usr/sbin"
BR2_ROOTFS_OVERLAY="$(BR2_EXTERNAL_BRWRAPPER_PATH)/board/pi4-touch-demo/fs-overlay"
BR2_ROOTFS_POST_BUILD_SCRIPT="board/raspberrypi4-64/post-build.sh"
BR2_ROOTFS_POST_IMAGE_SCRIPT="board/raspberrypi4-64/post-image.sh"
BR2_LINUX_KERNEL=y
BR2_LINUX_KERNEL_CUSTOM_TARBALL=y
BR2_LINUX_KERNEL_CUSTOM_TARBALL_LOCATION="$(call github,raspberrypi,linux,17f135b742c4edb340afb365873c3a574f7e16cb)/linux-17f135b742c4edb340afb365873c3a574f7e16cb.tar.gz"
BR2_LINUX_KERNEL_PATCH="$(BR2_EXTERNAL_BRWRAPPER_PATH)/board/pi4-touch-demo/linux-patches"
BR2_LINUX_KERNEL_USE_CUSTOM_CONFIG=y
BR2_LINUX_KERNEL_CUSTOM_CONFIG_FILE="$(BR2_EXTERNAL_BRWRAPPER_PATH)/board/pi4-touch-demo/linux.config"
BR2_LINUX_KERNEL_DTS_SUPPORT=y
BR2_LINUX_KERNEL_INTREE_DTS_NAME="broadcom/bcm2711-rpi-4-b"
BR2_LINUX_KERNEL_NEEDS_HOST_OPENSSL=y
BR2_PACKAGE_LINUX_TOOLS_GPIO=y
BR2_PACKAGE_XZ=y
BR2_PACKAGE_DEJAVU=y
BR2_PACKAGE_LIBERATION=y
BR2_PACKAGE_KMSCUBE=y
BR2_PACKAGE_MESA3D=y
BR2_PACKAGE_MESA3D_GALLIUM_DRIVER_V3D=y
BR2_PACKAGE_MESA3D_OPENGL_ES=y
BR2_PACKAGE_QT5=y
BR2_PACKAGE_QT5BASE_EXAMPLES=y
BR2_PACKAGE_QT5BASE_GUI=y
BR2_PACKAGE_QT5BASE_OPENGL_LIB=y
BR2_PACKAGE_QT5BASE_LINUXFB=y
BR2_PACKAGE_QT5BASE_EGLFS=y
BR2_PACKAGE_QT5BASE_GIF=y
BR2_PACKAGE_QT5BASE_JPEG=y
BR2_PACKAGE_QT5BASE_PNG=y
BR2_PACKAGE_QT5SENSORS=y
BR2_PACKAGE_RPI_FIRMWARE=y
BR2_PACKAGE_RPI_FIRMWARE_VARIANT_PI4=y
BR2_PACKAGE_RPI_FIRMWARE_CONFIG_FILE="$(BR2_EXTERNAL_BRWRAPPER_PATH)/board/pi4-touch-demo/raspberrypi4-64/config_4_64bit.txt"
BR2_PACKAGE_EVTEST=y
BR2_PACKAGE_I2C_TOOLS=y
BR2_PACKAGE_LINUXCONSOLETOOLS=y
BR2_PACKAGE_LINUXCONSOLETOOLS_FORCEFEEDBACK=y
BR2_PACKAGE_LIBGPIOD=y
BR2_PACKAGE_LIBGPIOD_TOOLS=y
BR2_PACKAGE_DROPBEAR=y
BR2_TARGET_ROOTFS_EXT2=y
BR2_TARGET_ROOTFS_EXT2_4=y
BR2_TARGET_ROOTFS_EXT2_SIZE="200M"
# BR2_TARGET_ROOTFS_TAR is not set
BR2_PACKAGE_HOST_DOSFSTOOLS=y
BR2_PACKAGE_HOST_GENIMAGE=y
BR2_PACKAGE_HOST_KMOD_XZ=y
BR2_PACKAGE_HOST_MTOOLS=y
BR2_PACKAGE_TOUCH_BLINK=y
```

## configs/raspberrypi5_touch_demo_defconfig
```kconfig
BR2_aarch64=y
BR2_cortex_a76_a55=y
BR2_ARM_FPU_VFPV4=y
BR2_PACKAGE_HOST_LINUX_HEADERS_CUSTOM_6_1=y
BR2_TOOLCHAIN_BUILDROOT_CXX=y
BR2_GLOBAL_PATCH_DIR="board/raspberrypi5/patches"
BR2_DOWNLOAD_FORCE_CHECK_HASHES=y
BR2_TARGET_GENERIC_ISSUE="Welcome to Brbox"
BR2_TARGET_GENERIC_ROOT_PASSWD="brb0x"
BR2_SYSTEM_DHCP="eth0"
BR2_ROOTFS_POST_BUILD_SCRIPT="board/raspberrypi5/post-build.sh"
BR2_ROOTFS_POST_IMAGE_SCRIPT="board/raspberrypi5/post-image.sh"
BR2_LINUX_KERNEL=y
BR2_LINUX_KERNEL_CUSTOM_TARBALL=y
BR2_LINUX_KERNEL_CUSTOM_TARBALL_LOCATION="$(call github,raspberrypi,linux,17f135b742c4edb340afb365873c3a574f7e16cb)/linux-17f135b742c4edb340afb365873c3a574f7e16cb.tar.gz"
BR2_LINUX_KERNEL_PATCH="$(BR2_EXTERNAL_BRWRAPPER_PATH)/board/pi5-touch-demo/linux-patches"
BR2_LINUX_KERNEL_USE_CUSTOM_CONFIG=y
BR2_LINUX_KERNEL_CUSTOM_CONFIG_FILE="$(BR2_EXTERNAL_BRWRAPPER_PATH)/board/pi5-touch-demo/linux.config"
BR2_LINUX_KERNEL_DTS_SUPPORT=y
BR2_LINUX_KERNEL_INTREE_DTS_NAME="broadcom/bcm2712-rpi-5-b"
BR2_LINUX_KERNEL_NEEDS_HOST_OPENSSL=y
BR2_PACKAGE_BUSYBOX_SHOW_OTHERS=y
BR2_PACKAGE_XZ=y
BR2_PACKAGE_RPI_FIRMWARE=y
BR2_PACKAGE_RPI_FIRMWARE_CONFIG_FILE="$(BR2_EXTERNAL_BRWRAPPER_PATH)/board/pi5-touch-demo/raspberrypi5/config_5.txt"
BR2_PACKAGE_RPI_FIRMWARE_CMDLINE_FILE="$(BR2_EXTERNAL_BRWRAPPER_PATH)/board/pi5-touch-demo/raspberrypi5/cmdline_5.txt"
# BR2_PACKAGE_RPI_FIRMWARE_INSTALL_DTB_OVERLAYS is not set
BR2_PACKAGE_EVTEST=y
BR2_PACKAGE_I2C_TOOLS=y
BR2_PACKAGE_LINUXCONSOLETOOLS=y
BR2_PACKAGE_LINUXCONSOLETOOLS_FORCEFEEDBACK=y
BR2_PACKAGE_DROPBEAR=y
BR2_PACKAGE_KMOD=y
BR2_PACKAGE_KMOD_TOOLS=y
BR2_TARGET_ROOTFS_EXT2=y
BR2_TARGET_ROOTFS_EXT2_4=y
BR2_TARGET_ROOTFS_EXT2_SIZE="120M"
# BR2_TARGET_ROOTFS_TAR is not set
BR2_PACKAGE_HOST_DOSFSTOOLS=y
BR2_PACKAGE_HOST_GENIMAGE=y
BR2_PACKAGE_HOST_KMOD_XZ=y
BR2_PACKAGE_HOST_MTOOLS=y
BR2_PACKAGE_TOUCH_BLINK=y
```

## configs/zynq_zed_defconfig
```kconfig
BR2_arm=y
BR2_cortex_a9=y
BR2_ARM_ENABLE_NEON=y
BR2_ARM_ENABLE_VFP=y
BR2_PACKAGE_HOST_LINUX_HEADERS_CUSTOM_5_10=y
BR2_TOOLCHAIN_BUILDROOT_CXX=y
BR2_TARGET_GENERIC_ROOT_PASSWD="root"
BR2_TARGET_GENERIC_GETTY_PORT="ttyPS0"
BR2_ROOTFS_OVERLAY="$(BR2_EXTERNAL_BRWRAPPER_PATH)/board/zed/fs-overlay"
BR2_ROOTFS_POST_IMAGE_SCRIPT="$(BR2_EXTERNAL_BRWRAPPER_PATH)/board/zed/post-image.sh $(BR2_EXTERNAL_BRWRAPPER_PATH)/board/zed/gen-sw-update-image.sh"
BR2_LINUX_KERNEL=y
BR2_LINUX_KERNEL_CUSTOM_GIT=y
BR2_LINUX_KERNEL_CUSTOM_REPO_URL="git://github.com/Xilinx/linux-xlnx.git"
BR2_LINUX_KERNEL_CUSTOM_REPO_VERSION="xlnx_rebase_v5.10"
BR2_LINUX_KERNEL_USE_CUSTOM_CONFIG=y
BR2_LINUX_KERNEL_CUSTOM_CONFIG_FILE="$(BR2_EXTERNAL_BRWRAPPER_PATH)/board/zed/linux/linux.config"
BR2_LINUX_KERNEL_UIMAGE=y
BR2_LINUX_KERNEL_UIMAGE_LOADADDR="0x8000"
BR2_LINUX_KERNEL_DTS_SUPPORT=y
BR2_LINUX_KERNEL_INTREE_DTS_NAME="zynq-zed"
BR2_LINUX_KERNEL_INSTALL_TARGET=y
BR2_PACKAGE_ZLIB=y
BR2_PACKAGE_LIBCONFIG=y
BR2_PACKAGE_JSON_C=y
BR2_PACKAGE_LIBJSON=y
BR2_PACKAGE_DROPBEAR=y
BR2_PACKAGE_SWUPDATE=y
BR2_PACKAGE_SWUPDATE_CONFIG="$(BR2_EXTERNAL_BRWRAPPER_PATH)/board/zed/swupdate.config"
# BR2_PACKAGE_SWUPDATE_WEBSERVER is not set
BR2_TARGET_ROOTFS_EXT2=y
BR2_TARGET_ROOTFS_EXT2_4=y
BR2_TARGET_ROOTFS_EXT2_SIZE="64M"
BR2_TARGET_ROOTFS_EXT2_GZIP=y
BR2_TARGET_ROOTFS_TAR_GZIP=y
BR2_TARGET_UBOOT=y
BR2_TARGET_UBOOT_BUILD_SYSTEM_KCONFIG=y
BR2_TARGET_UBOOT_CUSTOM_GIT=y
BR2_TARGET_UBOOT_CUSTOM_REPO_URL="https://github.com/Xilinx/u-boot-xlnx.git"
BR2_TARGET_UBOOT_CUSTOM_REPO_VERSION="xilinx-v2019.2"
BR2_TARGET_UBOOT_BOARD_DEFCONFIG="zynq_zed"
BR2_TARGET_UBOOT_NEEDS_DTC=y
BR2_TARGET_UBOOT_NEEDS_OPENSSL=y
BR2_TARGET_UBOOT_FORMAT_IMG=y
BR2_TARGET_UBOOT_SPL=y
BR2_TARGET_UBOOT_SPL_NAME="spl/boot.bin"
BR2_PACKAGE_HOST_DOSFSTOOLS=y
BR2_PACKAGE_HOST_GENIMAGE=y
BR2_PACKAGE_HOST_MTOOLS=y
```

## package/Config.in
```kconfig
source "$BR2_EXTERNAL_BRWRAPPER_PATH/package/xilinx-test-tools/Config.in"
source "$BR2_EXTERNAL_BRWRAPPER_PATH/package/preemptrt-gpiotest/Config.in"
source "$BR2_EXTERNAL_BRWRAPPER_PATH/package/aws-iot-device-sdk-cpp-v2/Config.in"
source "$BR2_EXTERNAL_BRWRAPPER_PATH/package/aws-iot-pubsub-agent/Config.in"
source "$BR2_EXTERNAL_BRWRAPPER_PATH/package/brbox_genintrdrv/Config.in"
source "$BR2_EXTERNAL_BRWRAPPER_PATH/package/touch-blink/Config.in"
source "$BR2_EXTERNAL_BRWRAPPER_PATH/package/hh983-serializer/Config.in"
```

## package/als-dimmer/Config.in
```kconfig
config BR2_PACKAGE_ALS_DIMMER
	bool "als-dimmer"
	depends on BR2_TOOLCHAIN_HAS_THREADS
	select BR2_PACKAGE_LIBDDCUTIL
	default n
	help
	  ALS-Dimmer: Ambient Light Sensor based display brightness
	  control daemon with DDC/CI support.

	  https://github.com/hackboxguy/als-dimmer
```

## package/aws-iot-device-sdk-cpp-v2/Config.in
```kconfig
config BR2_PACKAGE_AWS_IOT_DEVICE_SDK_CPP_V2
        bool "aws-iot-device-sdk-cpp-v2"
	default n
        help
          Next generation AWS IoT Client SDK for C++ using the AWS Common Runtime
```

## package/aws-iot-pubsub-agent/Config.in
```kconfig
config BR2_PACKAGE_AWS_IOT_PUBSUB_AGENT
        bool "aws-iot-pubsub-agent"
        select BR2_PACKAGE_AWS_IOT_DEVICE_SDK_CPP_V2
	default n
        help
          A demo pub-sub client agent for connecting to aws-iot-core
```

## package/car-can-emulator/Config.in
```kconfig
config BR2_PACKAGE_CAR_CAN_EMULATOR
	bool "car-can-emulator"
	help
	  CAN bus OBD2 emulator for testing automotive devices such as
	  head-up displays, instrument clusters, and car TCUs without
	  requiring a real vehicle.

	  Emulates standard OBD2 PIDs over CAN bus with a TCP control
	  interface for setting values at runtime.

	  https://github.com/hackboxguy/car-can-emulator

if BR2_PACKAGE_CAR_CAN_EMULATOR

config BR2_PACKAGE_CAR_CAN_EMULATOR_SYSTEMD
	bool "install systemd service"
	depends on BR2_INIT_SYSTEMD
	help
	  Install the systemd unit file for automatic startup.

endif
```

## package/disp-can-ctrl/Config.in
```kconfig
config BR2_PACKAGE_DISP_CAN_CTRL
    bool "disp-can-ctrl"
    depends on BR2_TOOLCHAIN_HAS_THREADS
    help
      Display CAN Control daemon with TCP and CAN bus interface
      for pattern control and hardware part number management.
```

## package/disp-settings/Config.in
```kconfig
config BR2_PACKAGE_DISP_SETTINGS
	bool "disp-settings"
	depends on BR2_PACKAGE_QT5
	select BR2_PACKAGE_QT5BASE_GUI
	select BR2_PACKAGE_QT5DECLARATIVE
	select BR2_PACKAGE_QT5QUICKCONTROLS2
	help
	  Qt5-based display settings application for embedded systems.
	  Provides UI for controlling display brightness, viewing FPGA
	  firmware info, temperature sensors, and touch controller status.

	  Communicates with als-dimmer service for brightness control
	  and directly with FPGA over I2C for hardware settings.

	  https://github.com/anthropics/disp-settings
```

## package/disp-tester/Config.in
```kconfig
config BR2_PACKAGE_DISP_TESTER
    bool "disp-tester"
    depends on BR2_PACKAGE_QT5
    select BR2_PACKAGE_QT5DECLARATIVE
    select BR2_PACKAGE_QT5QUICKCONTROLS2
    help
      Qt5-based display pattern generator for testing automotive
      displays. Features TCP network interface for automated
      color measurement integration. Optimized for embedded systems.
```

## package/hh983-serializer/Config.in
```kconfig
config BR2_PACKAGE_HH983_SERIALIZER
	bool "hh983-serializer"
	depends on BR2_LINUX_KERNEL
	help
	  HH983 FPDLink Serializer driver for I2C passthrough support.
```

## package/himax-touch/Config.in
```kconfig
config BR2_PACKAGE_HIMAX_TOUCH
	bool "himax-touch"
	depends on BR2_LINUX_KERNEL
	select BR2_PACKAGE_HH983_SERIALIZER
	help
	  Himax TDDI touchscreen driver (I2C) supporting HX83180,
	  HX83181, HX83192, HX83193 chips. Auto-detects connected
	  TDDI chip. Includes debug and self-test functions.
	  Installs DT overlay for RPi4.
```

## package/libddcutil/Config.in
```kconfig
config BR2_PACKAGE_LIBDDCUTIL
	bool "libddcutil"
	depends on BR2_TOOLCHAIN_HAS_THREADS
	select BR2_PACKAGE_LIBGLIB2
	select BR2_PACKAGE_JANSSON
	select BR2_PACKAGE_UDEV
	default n
	help
	  ddcutil is a program and library for querying and changing
	  monitor settings using DDC/CI and USB.

	  https://github.com/rockowitz/ddcutil
```

## package/micropanel/Config.in
```kconfig
config BR2_PACKAGE_MICROPANEL
        bool "micropanel"
        select BR2_PACKAGE_I2C_TOOLS
        select BR2_PACKAGE_JSON_FOR_MODERN_CPP
	default n
	depends on BR2_PACKAGE_HAS_UDEV
        help
          SSD1306 and keyinput HMI interface device service
```
